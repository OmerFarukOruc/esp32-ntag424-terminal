## components/hal_button/Kconfig
```kconfig
menu "HAL button"

    config HAL_BUTTON_GPIO
        int "Button GPIO"
        range 0 SOC_GPIO_IN_RANGE_MAX
        default 4
        help
            GPIO that the button connects to. The default wiring is the
            button between this GPIO and GND with the internal pull-up.

    config HAL_BUTTON_ACTIVE_LOW
        bool "Button reads low when pressed"
        default y
        help
            Enable for a button wired to GND. Disable for a button wired to
            the supply, which needs an external pull-down.

    config HAL_BUTTON_INTERNAL_PULLUP
        bool "Enable the internal pull-up"
        depends on HAL_BUTTON_ACTIVE_LOW
        default y
        help
            Disable this when the board has an external pull resistor. The
            pull-up holds the line high, so it is offered only with the
            low-when-pressed polarity above.

    config HAL_BUTTON_DEBOUNCE_MS
        int "Debounce time (ms)"
        range 10 500
        default 50
        help
            The level must stay stable this long after an edge before the
            press or release counts.

endmenu
```

## components/hal_indicator/Kconfig
```kconfig
menu "Indicator (hal_indicator)"

    config HAL_INDICATOR_LED_GPIO
        int "WS2812 status LED GPIO"
        range 0 SOC_GPIO_OUT_RANGE_MAX
        default 48
        help
            GPIO that drives the single WS2812 status LED. ESP32-S3-DevKitC-1
            v1.0 uses GPIO48 and v1.1 uses GPIO38. On modules with 1.8 V
            flash/PSRAM supply (ESP32-S3R8V), GPIO47 and GPIO48 run at 1.8 V.

    config HAL_INDICATOR_BUZZER_GPIO
        int "Buzzer GPIO"
        range 0 SOC_GPIO_OUT_RANGE_MAX
        default 10
        help
            GPIO that drives the buzzer through LEDC.

    choice HAL_INDICATOR_BUZZER_TYPE
        prompt "Buzzer type"
        default HAL_INDICATOR_BUZZER_ACTIVE
        help
            An active buzzer has its own oscillator and sounds while the pin is
            held at its on level; every sound has the same pitch. A passive
            buzzer needs a tone, so the pin gets a 50% duty PWM at the pitch
            of each beep.

        config HAL_INDICATOR_BUZZER_ACTIVE
            bool "Active buzzer (fixed pitch)"

        config HAL_INDICATOR_BUZZER_PASSIVE
            bool "Passive buzzer (PWM tone)"
    endchoice

    config HAL_INDICATOR_BUZZER_ACTIVE_LOW
        bool "Active buzzer sounds when the pin is low"
        depends on HAL_INDICATOR_BUZZER_ACTIVE
        default y
        help
            Enable when the buzzer circuit sounds with the pin at 0 V and stays
            silent with the pin at 3.3 V.

endmenu
```

## components/hal_nfc/Kconfig
```kconfig
menu "HAL NFC"

    config HAL_NFC_UART_NUM
        int "UART port connected to the PN532"
        range 1 2
        default 1
        help
            UART port that drives the PN532 in HSU mode. UART0 stays free for
            the console.

    config HAL_NFC_TX_GPIO
        int "GPIO for ESP32 TX (PN532 RX)"
        range 0 SOC_GPIO_OUT_RANGE_MAX
        default 17
        help
            GPIO that carries data from the ESP32 to the PN532 RX pin.

    config HAL_NFC_RX_GPIO
        int "GPIO for ESP32 RX (PN532 TX)"
        range 0 SOC_GPIO_IN_RANGE_MAX
        default 18
        help
            GPIO that carries data from the PN532 TX pin to the ESP32.

    config HAL_NFC_SDM_BASE_URL
        string "SDM base URL"
        default "https://example.com/tap"
        help
            URL prefix written into the NTAG424 DNA NDEF file. The terminal
            appends "/<device_id>?picc_data=<32 hex>&cmac=<16 hex>" and lets the
            tag fill the placeholders through Secure Dynamic Messaging. The
            backend that receives the tap must serve this path. Do not end the
            value with a slash. The value may be at most 139 characters so the
            whole NDEF file fits one DESFire WriteData frame; the build fails
            when it is longer.

            Key limitation: the terminal authenticates with, and leaves in
            place, the factory all-zero AES-128 keys (key 0 and the SDM file
            read key). It never calls ChangeKey, because an interrupted key
            change can lock a tag for good. Anyone who knows this firmware can
            therefore decrypt picc_data and compute a valid cmac, so SDM proves
            only that a tap happened, not that a genuine tag produced it. A tag
            whose key 0 was changed cannot be configured by this firmware.

endmenu
```

## components/hal_power/Kconfig
```kconfig
menu "HAL power"

    config HAL_POWER_BATTERY_MONITOR
        bool "Monitor the battery voltage"
        default n
        help
            Enable only on a board that has the battery voltage divider wired
            to the sense pin below. When enabled, the application starts the
            monitor, shows the low battery pattern, and puts the device into
            deep sleep at a critical level. Only a reset wakes it again.

            Leave this off on a board without the divider. The sense pin then
            floats, and a reading between the absent-battery and the critical
            threshold would put the device to sleep after every boot.

    config HAL_POWER_ADC_CHANNEL
        int "Battery sense ADC1 channel"
        range 0 9
        default 0
        help
            ADC1 channel that reads the battery through a 1:2 voltage divider.
            On the ESP32-S3, ADC1 channel N is GPIO N+1, so the default 0 is
            GPIO1.

endmenu
```

## components/hal_time/Kconfig
```kconfig
menu "HAL time"

    config HAL_TIME_NTP_SERVER_PRIMARY
        string "Primary NTP server"
        default "pool.ntp.org"

    config HAL_TIME_NTP_SERVER_SECONDARY
        string "Secondary NTP server (empty for none)"
        default "time.google.com"
        help
            The build needs CONFIG_LWIP_SNTP_MAX_SERVERS of at least 2, which
            sdkconfig.defaults sets. The lwIP default is 1.

endmenu
```
